/**
 * @file fc_settings.c
 * @brief LVGL image asset with multi-format support
 *
 * Generated by PicoPixel.io — https://picopixel.io
 *
 * Image: fc_settings
 * Size: 32 x 32 pixels
 * Has transparency: Yes
 *
 * Color format is selected at compile time based on LV_COLOR_DEPTH:
 * - LV_COLOR_DEPTH == 32: ARGB8888 (best quality, full alpha)
 * - LV_COLOR_DEPTH == 16 with alpha: RGB565A8 (16-bit color + 8-bit alpha)
 * - LV_COLOR_DEPTH == 16 without alpha: RGB565
 */

#include "../screens.h"

#ifndef LV_ATTRIBUTE_MEM_ALIGN
#define LV_ATTRIBUTE_MEM_ALIGN
#endif

#ifndef LV_ATTRIBUTE_LARGE_CONST
#define LV_ATTRIBUTE_LARGE_CONST
#endif

#ifndef LV_ATTRIBUTE_IMG_FC_SETTINGS
#define LV_ATTRIBUTE_IMG_FC_SETTINGS
#endif

#ifndef LV_COLOR_16_SWAP
#define LV_COLOR_16_SWAP 0
#endif

/* ============================================================================
 * TRUE_COLOR_ALPHA (ARGB8888) - 32-bit displays with full alpha support
 * ============================================================================ */
#if LV_COLOR_DEPTH == 32

static const LV_ATTRIBUTE_MEM_ALIGN LV_ATTRIBUTE_LARGE_CONST LV_ATTRIBUTE_IMG_FC_SETTINGS uint8_t fc_settings_argb8888_map[] = {
    0x00, 0x00, 0x00, 0x00, 0x00, 0x00, 0x00, 0x00, 0x00, 0x00, 0x00, 0x00, 0x00, 0x00, 0x00, 0x00,
    0x00, 0x00, 0x00, 0x00, 0x00, 0x00, 0x00, 0x00, 0x00, 0x00, 0x00, 0x00, 0x00, 0x00, 0x00, 0x00,
    0x00, 0x00, 0x00, 0x00, 0x00, 0x00, 0x00, 0x00, 0x00, 0x00, 0x00, 0x00, 0x00, 0x00, 0x00, 0x00,
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    0x00, 0x00, 0x00, 0x00, 0x00, 0x00, 0x00, 0x00, 0x00, 0x00, 0x00, 0x00, 0x00, 0x00, 0x00, 0x00,
};

#elif LV_COLOR_DEPTH == 16

/* ============================================================================
 * 16-bit display formats
 * ============================================================================ */

#if LV_COLOR_16_SWAP == 0
/* RGB565A8 - 16-bit color with separate 8-bit alpha channel (standard byte order) */

static const LV_ATTRIBUTE_MEM_ALIGN LV_ATTRIBUTE_LARGE_CONST LV_ATTRIBUTE_IMG_FC_SETTINGS uint8_t fc_settings_rgb565a8_map[] = {
    /* RGB565 color data (2048 bytes) */
    0x00, 0x00, 0x00, 0x00, 0x00, 0x00, 0x00, 0x00, 0x00, 0x00, 0x00, 0x00, 0x00, 0x00, 0x00, 0x00,
    0x00, 0x00, 0x00, 0x00, 0x00, 0x00, 0x00, 0x00, 0x00, 0x00, 0x00, 0x00, 0x00, 0x00, 0x00, 0x00,
    0x00, 0x00, 0x00, 0x00, 0x00, 0x00, 0x00, 0x00, 0x00, 0x00, 0x00, 0x00, 0x00, 0x00, 0x00, 0x00,
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    0x00, 0x00, 0x00, 0x00, 0x00, 0x00, 0x00, 0x00, 0x00, 0x00, 0x00, 0x00, 0x00, 0x00, 0x00, 0x00,
    /* Alpha channel data (1024 bytes) */
    0x00, 0x00, 0x00, 0x00, 0x00, 0x00, 0x00, 0x00, 0x00, 0x00, 0x00, 0x00, 0x00, 0x00, 0x00, 0x00,
    0x00, 0x00, 0x00, 0x00, 0x00, 0x00, 0x00, 0x00, 0x00, 0x00, 0x00, 0x00, 0x00, 0x00, 0x00, 0x00,
    0x00, 0x00, 0x00, 0x00, 0x00, 0x00, 0x00, 0x00, 0x00, 0x00, 0x00, 0x00, 0x00, 0x00, 0x00, 0x00,
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    0x00, 0x00, 0x00, 0x00, 0x00, 0x00, 0x00, 0x00, 0x00, 0x00, 0x00, 0x00, 0x00, 0x00, 0x00, 0x00,
};
#else
/* RGB565A8 - 16-bit color with separate 8-bit alpha channel (swapped byte order) */

static const LV_ATTRIBUTE_MEM_ALIGN LV_ATTRIBUTE_LARGE_CONST LV_ATTRIBUTE_IMG_FC_SETTINGS uint8_t fc_settings_rgb565a8_swap_map[] = {
    /* RGB565 color data (2048 bytes, byte-swapped) */
    0x00, 0x00, 0x00, 0x00, 0x00, 0x00, 0x00, 0x00, 0x00, 0x00, 0x00, 0x00, 0x00, 0x00, 0x00, 0x00,
    0x00, 0x00, 0x00, 0x00, 0x00, 0x00, 0x00, 0x00, 0x00, 0x00, 0x00, 0x00, 0x00, 0x00, 0x00, 0x00,
    0x00, 0x00, 0x00, 0x00, 0x00, 0x00, 0x00, 0x00, 0x00, 0x00, 0x00, 0x00, 0x00, 0x00, 0x00, 0x00,
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    0x00, 0x00, 0x00, 0x00, 0x00, 0x00, 0x00, 0x00, 0x00, 0x00, 0x00, 0x00, 0x00, 0x00, 0x00, 0x00,
    /* Alpha channel data (1024 bytes) */
    0x00, 0x00, 0x00, 0x00, 0x00, 0x00, 0x00, 0x00, 0x00, 0x00, 0x00, 0x00, 0x00, 0x00, 0x00, 0x00,
    0x00, 0x00, 0x00, 0x00, 0x00, 0x00, 0x00, 0x00, 0x00, 0x00, 0x00, 0x00, 0x00, 0x00, 0x00, 0x00,
    0x00, 0x00, 0x00, 0x00, 0x00, 0x00, 0x00, 0x00, 0x00, 0x00, 0x00, 0x00, 0x00, 0x00, 0x00, 0x00,
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    0x00, 0x00, 0x00, 0x00, 0x00, 0x00, 0x00, 0x00, 0x00, 0x00, 0x00, 0x00, 0x00, 0x00, 0x00, 0x00,
};
#endif


#elif LV_COLOR_DEPTH == 8

#error "8-bit color depth (LV_COLOR_DEPTH == 8) is not yet supported for image export. Use 16 or 32-bit."

#else
#error "Unsupported LV_COLOR_DEPTH. Please use 16 or 32."
#endif

const lv_img_dsc_t fc_settings = {
#if LV_COLOR_DEPTH == 32
    .header.cf = LV_IMG_CF_TRUE_COLOR_ALPHA,
    .header.always_zero = 0,
    .header.reserved = 0,
    .header.w = 32,
    .header.h = 32,
    .data_size = 4096,
    .data = fc_settings_argb8888_map,
#elif LV_COLOR_DEPTH == 16
    .header.cf = LV_IMG_CF_RGB565A8,
    .header.always_zero = 0,
    .header.reserved = 0,
    .header.w = 32,
    .header.h = 32,
    .data_size = 3072, /* RGB565 (2048) + Alpha (1024) */
#if LV_COLOR_16_SWAP == 0
    .data = fc_settings_rgb565a8_map,
#else
    .data = fc_settings_rgb565a8_swap_map,
#endif
#endif
};
